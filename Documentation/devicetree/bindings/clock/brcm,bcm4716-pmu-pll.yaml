## Documentation/devicetree/bindings/clock/brcm,bcm4716-pmu-pll.yaml
```yaml
# SPDX-License-Identifier: (GPL-2.0-only OR BSD-2-Clause)
%YAML 1.2
---
$id: http://devicetree.org/schemas/clock/brcm,bcm4716-pmu-pll.yaml#
$schema: http://devicetree.org/meta-schemas/core.yaml#

title: Broadcom BCM4716 PMU main PLL

maintainers:
  - Rosen Penev <rosenp@gmail.com>

description: >
  The PMU (Power Management Unit) in the ChipCommon core of BCM4716, BCM4717
  and BCM4718 SoCs contains a main PLL running off the crystal. It has
  outputs for the CPU, the memory controller and the backplane. The boot
  loader programs the PLL and the rates are read back from its control
  words.

  The PLL registers are part of ChipCommon, so this node must be a child of
  the ChipCommon syscon node.

  The clock specifier values are defined in
  include/dt-bindings/clock/brcm,bcm4716-pmu-pll.h.

properties:
  compatible:
    const: brcm,bcm4716-pmu-pll

  clocks:
    description: Crystal (ALP) clock
    maxItems: 1

  '#clock-cells':
    const: 1

required:
  - compatible
  - clocks
  - '#clock-cells'

additionalProperties: false

examples:
  - |
    clock-controller {
        compatible = "brcm,bcm4716-pmu-pll";
        clocks = <&xtal>;
        #clock-cells = <1>;
    };
```

## Documentation/devicetree/bindings/clock/ti,keystone-pll.yaml
```yaml
# SPDX-License-Identifier: (GPL-2.0-only OR BSD-2-Clause)
%YAML 1.2
---
$id: http://devicetree.org/schemas/clock/ti,keystone-pll.yaml#
$schema: http://devicetree.org/meta-schemas/core.yaml#

title: Texas Instruments Keystone PLL Clocks

maintainers:
  - Murali Karicheri <m-karicheri2@ti.com>

description: |
  Binding for Keystone PLLs. The main PLL IP typically has a multiplier,
  a divider and a post divider. The additional PLL IPs like ARMPLL, DDRPLL
  and PAPLL are controlled by the memory mapped register where as the Main
  PLL is controlled by a PLL controller registers along with memory mapped
  registers.

  This binding uses the common clock binding[1].

  [1] Documentation/devicetree/bindings/clock/clock-bindings.txt

  There are four compatible strings supported:

  - "ti,keystone,main-pll-clock": Main PLL with multiplier, pre-divider
    and post-divider.
  - "ti,keystone,pll-clock": Additional PLLs (ARMPLL, DDRPLL, PAPLL).
  - "ti,keystone,pll-mux-clock": PLL mux for selecting between PLL output
    and bypass clock.
  - "ti,keystone,pll-divider-clock": PLL output divider.

properties:
  compatible:
    enum:
      - ti,keystone,main-pll-clock
      - ti,keystone,pll-clock
      - ti,keystone,pll-mux-clock
      - ti,keystone,pll-divider-clock

  "#clock-cells":
    const: 0

  clocks:
    description:
      For main-pll-clock and pll-clock, a single parent clock phandle.
      For pll-mux-clock, two parent clock phandles (PLL output and bypass).
      For pll-divider-clock, a single parent clock phandle.

  clock-output-names:
    description: From common clock binding to override the default output
      clock name.

  reg:
    description: |
      Register base and size for the clock control registers.
      For main-pll-clock: control, multiplier and post-divider registers.
      For pll-clock: control register.
      For pll-mux-clock: mux register.
      For pll-divider-clock: divider register.
    minItems: 1
    maxItems: 3

  reg-names:
    description: |
      Names for the registers. Required for main-pll-clock and pll-clock
      to identify "control", "multiplier" and "post-divider" registers.
    minItems: 1
    maxItems: 3

  fixed-postdiv:
    description: Fixed post divider value. If absent, use clkod register
      bits for postdiv. Only applicable to main-pll-clock.
    $ref: /schemas/types.yaml#/definitions/uint32

  bit-shift:
    description: Number of bits to shift the bit-mask. Only applicable to
      pll-mux-clock and pll-divider-clock.
    $ref: /schemas/types.yaml#/definitions/uint32

  bit-mask:
    description: Arbitrary bitmask for programming the mux or divider.
      Only applicable to pll-mux-clock and pll-divider-clock.
    $ref: /schemas/types.yaml#/definitions/uint32

allOf:
  - if:
      properties:
        compatible:
          contains:
            const: ti,keystone,main-pll-clock
    then:
      required:
        - reg
        - reg-names
        - clocks

  - if:
      properties:
        compatible:
          contains:
            const: ti,keystone,pll-clock
    then:
      required:
        - reg
        - clocks

  - if:
      properties:
        compatible:
          contains:
            const: ti,keystone,pll-mux-clock
    then:
      required:
        - reg
        - clocks
        - bit-shift
        - bit-mask

  - if:
      properties:
        compatible:
          contains:
            const: ti,keystone,pll-divider-clock
    then:
      required:
        - reg
        - clocks
        - bit-shift
        - bit-mask

additionalProperties: false

examples:
  - |
    clocks {
        #address-cells = <1>;
        #size-cells = <1>;

        mainpllclk: mainpllclk@2310110 {
            #clock-cells = <0>;
            compatible = "ti,keystone,main-pll-clock";
            clocks = <&refclksys>;
            reg = <0x02620350 4>, <0x02310110 4>, <0x02310108 4>;
            reg-names = "control", "multiplier", "post-divider";
            fixed-postdiv = <2>;
        };

        papllclk: papllclk@2620358 {
            #clock-cells = <0>;
            compatible = "ti,keystone,pll-clock";
            clocks = <&refclkpass>;
            clock-output-names = "pa-pll-clk";
            reg = <0x02620358 4>;
            reg-names = "control";
        };

        mainmuxclk: mainmuxclk@2310108 {
            #clock-cells = <0>;
            compatible = "ti,keystone,pll-mux-clock";
            clocks = <&mainpllclk>, <&refclksys>;
            reg = <0x02310108 4>;
            bit-shift = <23>;
            bit-mask = <1>;
            clock-output-names = "mainmuxclk";
        };

        gemtraceclk: gemtraceclk@2310120 {
            #clock-cells = <0>;
            compatible = "ti,keystone,pll-divider-clock";
            clocks = <&mainmuxclk>;
            reg = <0x02310120 4>;
            bit-shift = <0>;
            bit-mask = <8>;
            clock-output-names = "gemtraceclk";
        };
    };
```

## Documentation/devicetree/bindings/clock/ti,keystone-psc.yaml
```yaml
# SPDX-License-Identifier: (GPL-2.0-only OR BSD-2-Clause)
%YAML 1.2
---
$id: http://devicetree.org/schemas/clock/ti,keystone-psc.yaml#
$schema: http://devicetree.org/meta-schemas/core.yaml#

title: Texas Instruments Keystone PSC Clock

maintainers:
  - Murali Karicheri <m-karicheri2@ti.com>

description: |
  Binding for Keystone gate control driver which uses PSC (Power Sleep
  Controller) IP for clock gating.

  This binding uses the common clock binding[1].

  [1] Documentation/devicetree/bindings/clock/clock-bindings.txt

properties:
  compatible:
    const: ti,keystone,psc-clock

  "#clock-cells":
    const: 0

  clocks:
    description: Parent clock phandle.

  clock-output-names:
    description: From common clock binding to override the default output
      clock name.

  reg:
    description: PSC control and domain register base addresses and sizes.
    minItems: 2
    maxItems: 2

  reg-names:
    description: Must be "control" and "domain".
    items:
      - const: control
      - const: domain

  domain-id:
    description: PSC domain id needed to check the transition state register.
    $ref: /schemas/types.yaml#/definitions/uint32

required:
  - compatible
  - "#clock-cells"
  - clocks
  - reg
  - reg-names
  - domain-id

additionalProperties: false

examples:
  - |
    clocks {
        clkusb: clkusb@2350008 {
            #clock-cells = <0>;
            compatible = "ti,keystone,psc-clock";
            clocks = <&chipclk16>;
            clock-output-names = "usb";
            reg = <0x02350008 0xb00>, <0x02350000 0x400>;
            reg-names = "control", "domain";
            domain-id = <0>;
        };
    };
```

## Documentation/devicetree/bindings/interrupt-controller/brcm,bcm4718-mips74k-intc.yaml
```yaml
# SPDX-License-Identifier: (GPL-2.0-only OR BSD-2-Clause)
%YAML 1.2
---
$id: http://devicetree.org/schemas/interrupt-controller/brcm,bcm4718-mips74k-intc.yaml#
$schema: http://devicetree.org/meta-schemas/core.yaml#

title: Broadcom BCM47xx MIPS74K core interrupt router

maintainers:
  - Rosen Penev <rosenp@gmail.com>

description:
  The MIPS74K core of BCMA based BCM47xx SoCs routes the backplane interrupt
  flags of the other cores to the CPU interrupt lines. Each of its INTMASK
  registers selects the flags that raise one CPU line, and its INTSTATUS
  register holds the state of all flags. The interrupt specifier is the
  backplane flag of the core.

properties:
  compatible:
    const: brcm,bcm4718-mips74k-intc

  reg:
    maxItems: 1

  '#address-cells':
    const: 0

  interrupt-controller: true

  '#interrupt-cells':
    const: 1

  interrupts:
    description:
      The CPU interrupt lines raised through the INTMASK registers, in
      register order. Any number of flags can share the first line, the
      others carry one flag each.
    minItems: 1
    items:
      - description: CPU line of INTMASK0, shared
      - description: CPU line of INTMASK1
      - description: CPU line of INTMASK2
      - description: CPU line of INTMASK3
      - description: CPU line of INTMASK4

required:
  - compatible
  - reg
  - interrupt-controller
  - '#interrupt-cells'
  - interrupts

additionalProperties: false

examples:
  - |
    interrupt-controller@18003000 {
        compatible = "brcm,bcm4718-mips74k-intc";
        reg = <0x18003000 0x1000>;
        #address-cells = <0>;
        #interrupt-cells = <1>;
        interrupt-controller;
        interrupts = <2>, <3>, <4>, <5>, <6>;
    };
```

## Documentation/devicetree/bindings/mfd/brcm,bcm4716-chipcommon.yaml
```yaml
# SPDX-License-Identifier: (GPL-2.0-only OR BSD-2-Clause)
%YAML 1.2
---
$id: http://devicetree.org/schemas/mfd/brcm,bcm4716-chipcommon.yaml#
$schema: http://devicetree.org/meta-schemas/core.yaml#

title: Broadcom BCM4716 ChipCommon

maintainers:
  - Rosen Penev <rosenp@gmail.com>

description: >
  ChipCommon is the first core on the AXI backplane of BCM4716, BCM4717 and
  BCM4718 SoCs. Among others it holds the GPIO controller, the UART, the
  watchdog, the flash controller and the PMU. The bcma bus driver handles
  the GPIO controller. The UART and the PMU clocks are described as child
  nodes.

properties:
  compatible:
    items:
      - const: brcm,bcm4716-chipcommon
      - const: syscon
      - const: simple-mfd

  reg:
    maxItems: 1

  ranges: true

  '#address-cells':
    const: 1

  '#size-cells':
    const: 1

  gpio-controller: true

  '#gpio-cells':
    const: 2

  interrupt-controller: true

  '#interrupt-cells':
    const: 2

  clock-controller:
    $ref: /schemas/clock/brcm,bcm4716-pmu-pll.yaml#

patternProperties:
  '^serial@[0-9a-f]+$':
    type: object

required:
  - compatible
  - reg

additionalProperties: false

examples:
  - |
    chipcommon@18000000 {
        compatible = "brcm,bcm4716-chipcommon", "syscon", "simple-mfd";
        reg = <0x18000000 0x1000>;
        ranges = <0 0x18000000 0x1000>;
        #address-cells = <1>;
        #size-cells = <1>;
        gpio-controller;
        #gpio-cells = <2>;

        clock-controller {
            compatible = "brcm,bcm4716-pmu-pll";
            clocks = <&xtal>;
            #clock-cells = <1>;
        };

        serial@300 {
            compatible = "ns16550a";
            reg = <0x300 0x100>;
            clock-frequency = <20000000>;
        };
    };
```

## Documentation/devicetree/bindings/mips/brcm/bcm47xx.yaml
```yaml
# SPDX-License-Identifier: (GPL-2.0-only OR BSD-2-Clause)
%YAML 1.2
---
$id: http://devicetree.org/schemas/mips/brcm/bcm47xx.yaml#
$schema: http://devicetree.org/meta-schemas/core.yaml#

title: Broadcom BCM47xx MIPS based platforms

maintainers:
  - Hauke Mehrtens <hauke@hauke-m.de>
  - Rafał Miłecki <zajec5@gmail.com>

description:
  Wireless routers and access points built around the MIPS 74K based
  BCM47xx SoCs, whose cores sit on a Broadcom AXI (bcma) bus.

properties:
  $nodename:
    const: '/'

  compatible:
    oneOf:
      - description: BCM4718 based boards
        items:
          - enum:
              - asus,rt-n16
          - const: brcm,bcm4718

additionalProperties: true

...
```

## Documentation/devicetree/bindings/phy/brcm,bcm4716-usb-phy.yaml
```yaml
# SPDX-License-Identifier: (GPL-2.0-only OR BSD-2-Clause)
%YAML 1.2
---
$id: http://devicetree.org/schemas/phy/brcm,bcm4716-usb-phy.yaml#
$schema: http://devicetree.org/meta-schemas/core.yaml#

title: Broadcom BCM4716 USB 2.0 PHY

maintainers:
  - Rosen Penev <rosenp@gmail.com>

description: >
  The USB 2.0 host core of BCM4716, BCM4717 and BCM4718 SoCs contains an
  EHCI and an OHCI controller sharing one PHY. The host control register
  and the shim MDIO interface to the PHY follow the EHCI registers, from
  offset 0x200 of the core. The PHY driver also takes the core out of
  reset, once for both controllers.

properties:
  compatible:
    const: brcm,bcm4716-usb-phy

  reg:
    maxItems: 1

  clocks:
    description: CPU clock, which sets the clock and data recovery mode
    maxItems: 1

  resets:
    description: Reset of the USB host core wrapper
    maxItems: 1

  phy-supply:
    description: Regulator switching the VBUS of the USB ports

  '#phy-cells':
    const: 0

required:
  - compatible
  - reg
  - clocks
  - resets
  - '#phy-cells'

additionalProperties: false

examples:
  - |
    #include <dt-bindings/clock/brcm,bcm4716-pmu-pll.h>

    phy@18004200 {
        compatible = "brcm,bcm4716-usb-phy";
        reg = <0x18004200 0x400>;
        clocks = <&pmu_pll BCM4716_PMU_PLL_CPU>;
        resets = <&usb_wrapper>;
        #phy-cells = <0>;
    };
```

## Documentation/devicetree/bindings/reset/brcm,bcm4716-wrapper-reset.yaml
```yaml
# SPDX-License-Identifier: (GPL-2.0-only OR BSD-2-Clause)
%YAML 1.2
---
$id: http://devicetree.org/schemas/reset/brcm,bcm4716-wrapper-reset.yaml#
$schema: http://devicetree.org/meta-schemas/core.yaml#

title: Broadcom BCM4716 core wrapper reset controller

maintainers:
  - Rosen Penev <rosenp@gmail.com>

description: >
  Each core on the AXI backplane of BCM4716, BCM4717 and BCM4718 SoCs has
  an agent wrapper, in the 0x18100000 region, that gates the clock of the
  core and holds it in reset. Each wrapper is one reset line, released
  together with the core clock.

properties:
  compatible:
    const: brcm,bcm4716-wrapper-reset

  reg:
    maxItems: 1

  '#reset-cells':
    const: 0

required:
  - compatible
  - reg
  - '#reset-cells'

additionalProperties: false

examples:
  - |
    reset-controller@18104000 {
        compatible = "brcm,bcm4716-wrapper-reset";
        reg = <0x18104000 0x1000>;
        #reset-cells = <0>;
    };
```

## Documentation/devicetree/bindings/watchdog/brcm,bcm4716-wdt.yaml
```yaml
# SPDX-License-Identifier: (GPL-2.0-only OR BSD-2-Clause)
%YAML 1.2
---
$id: http://devicetree.org/schemas/watchdog/brcm,bcm4716-wdt.yaml#
$schema: http://devicetree.org/meta-schemas/core.yaml#

title: Broadcom BCM4716 watchdog timer

maintainers:
  - Rosen Penev <rosenp@gmail.com>

description: >
  The PMU in the ChipCommon core of BCM4716, BCM4717 and BCM4718 SoCs has a
  watchdog timer. It counts down at the 32 kHz ILP rate and resets the chip
  when it expires.

  The watchdog registers are part of ChipCommon, so this node must be a
  child of the ChipCommon syscon node.

allOf:
  - $ref: watchdog.yaml#

properties:
  compatible:
    const: brcm,bcm4716-wdt

required:
  - compatible

unevaluatedProperties: false

examples:
  - |
    watchdog {
        compatible = "brcm,bcm4716-wdt";
    };
```

## arch/mips/ath79/Kconfig
```kconfig
# SPDX-License-Identifier: GPL-2.0
if ATH79

config SOC_AR71XX
	select HAVE_PCI
	def_bool n

config PCI_AR724X
	def_bool n

endif
```
