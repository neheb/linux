## arch/mips/bcm47xx/Kconfig
```kconfig
# SPDX-License-Identifier: GPL-2.0
if BCM47XX

config BCM47XX_SSB
	bool "SSB Support for Broadcom BCM47XX"
	select SYS_HAS_CPU_BMIPS32_3300
	select SSB
	select SSB_HOST_SOC
	select SSB_DRIVER_MIPS
	select SSB_DRIVER_EXTIF
	select SSB_EMBEDDED
	select SSB_PCIHOST if PCI
	select SSB_B43_PCI_BRIDGE if PCI
	select SSB_DRIVER_PCICORE if PCI
	select SSB_PCICORE_HOSTMODE if PCI
	select SSB_DRIVER_GPIO
	default y
	help
	  Add support for old Broadcom BCM47xx boards with Sonics Silicon Backplane support.

	  This will generate an image with support for SSB and MIPS32 R1 instruction set.

config BCM47XX_BCMA
	bool "BCMA Support for Broadcom BCM47XX"
	select SYS_HAS_CPU_MIPS32_R2
	select SYS_SUPPORTS_HIGHMEM
	select CPU_MIPSR2_IRQ_VI
	select BCMA
	select BCMA_HOST_SOC
	select BCMA_DRIVER_MIPS
	select BCMA_DRIVER_PCI if PCI
	select BCMA_DRIVER_PCI_HOSTMODE if PCI
	select BCMA_DRIVER_GPIO
	default y
	help
	  Add support for new Broadcom BCM47xx boards with Broadcom specific Advanced Microcontroller Bus.

	  This will generate an image with support for BCMA and MIPS32 R2 instruction set.

config BCM47XX_OF
	bool "Device Tree support for BCMA based BCM47XX boards"
	depends on BCM47XX_BCMA
	select USE_OF
	select BUILTIN_DTB
	help
	  Describe the board with a device tree instead of the built-in
	  tables selected by NVRAM. CFE does not pass a device tree, so
	  the board's device tree is built into the kernel.

	  If no device tree is found, the built-in board tables are used.

endif
```

## drivers/clk/mmp/Kconfig
```kconfig
# SPDX-License-Identifier: GPL-2.0-only

config COMMON_CLK_MMP
	bool
	default ARCH_MMP

config COMMON_CLK_PXA168
	bool "Clock driver for Marvell PXA168"
	depends on ARCH_MMP || COMPILE_TEST
	depends on OF
	default y if MACH_MMP_DT
	select COMMON_CLK_MMP
	help
	  This driver supports the Marvell PXA168 SoC clocks.

config COMMON_CLK_PXA910
	bool "Clock driver for Marvell PXA910"
	depends on ARCH_MMP || COMPILE_TEST
	depends on OF
	default y if MACH_MMP_DT
	select COMMON_CLK_MMP
	help
	  This driver supports the Marvell PXA910 SoC clocks.

config COMMON_CLK_PXA1928
	bool "Clock driver for Marvell PXA1928"
	depends on ARCH_MMP || COMPILE_TEST
	depends on OF
	default y if ARCH_MMP
	select COMMON_CLK_MMP
	help
	  This driver supports the Marvell PXA1928 SoC clocks.

config COMMON_CLK_PXA1908
	bool "Clock driver for Marvell PXA1908"
	depends on ARCH_MMP || COMPILE_TEST
	depends on OF
	default y if ARCH_MMP && ARM64
	select COMMON_CLK_MMP
	select AUXILIARY_BUS
	help
	  This driver supports the Marvell PXA1908 SoC clocks.
```
