## Documentation/devicetree/bindings/gpio/qca,ar-gpio.yaml
```yaml
# SPDX-License-Identifier: GPL-2.0 OR BSD-2-Clause
%YAML 1.2
---
$id: "http://devicetree.org/schemas/gpio/qca,ar-gpio.yaml#"
$schema: http://devicetree.org/meta-schemas/core.yaml#

title: Qualcomm Atheros AR7xxx/AR9xxx GPIO controller

maintainers:
  - Alban Bedel <albeu@free.fr>

properties:
  compatible:
    enum:
      - qca,ar7100-gpio
      - qca,ar9340-gpio

  reg:
    maxItems: 1

  interrupts:
    maxItems: 1

  ngpios:
    minimum: 1
    maximum: 32

  gpio-controller: true

  "#gpio-cells":
    const: 2

  interrupt-controller: true

  "#interrupt-cells":
    const: 2

additionalProperties: false

required:
  - compatible
  - reg
  - gpio-controller
  - "#gpio-cells"
  - ngpios


examples:
  - |
    gpio@18040000 {
      compatible = "qca,ar7100-gpio";
      reg = <0x18040000 0x30>;
      interrupts = <2>;

      gpio-controller;
      #gpio-cells = <2>;

      ngpios = <22>;

      interrupt-controller;
      #interrupt-cells = <2>;
    };
```

## Documentation/devicetree/bindings/watchdog/qca,ar7130-wdt.yaml
```yaml
# SPDX-License-Identifier: (GPL-2.0-only OR BSD-2-Clause)
%YAML 1.2
---
$id: http://devicetree.org/schemas/watchdog/qca,ar7130-wdt.yaml#
$schema: http://devicetree.org/meta-schemas/core.yaml#

title: Qualcomm Atheros AR7130 Watchdog Timer (WDT) Controller

maintainers:
  - Gabor Juhos <juhosg@openwrt.org>

allOf:
  - $ref: watchdog.yaml#

properties:
  compatible:
    const: qca,ar7130-wdt

  reg:
    maxItems: 1

  interrupts:
    maxItems: 1

  clocks:
    maxItems: 1

  clock-names:
    const: wdt

required:
  - compatible
  - reg
  - interrupts
  - clocks
  - clock-names

unevaluatedProperties: false

examples:
  - |
    watchdog@18060008 {
        compatible = "qca,ar7130-wdt";
        reg = <0x18060008 0x8>;

        interrupts = <4>;

        clocks = <&pll ATH79_CLK_AHB>;
        clock-names = "wdt";
    };
```
